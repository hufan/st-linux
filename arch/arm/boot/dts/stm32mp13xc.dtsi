// SPDX-License-Identifier: (GPL-2.0+ OR BSD-3-Clause)
/*
 * Copyright (C) STMicroelectronics 2019 - All Rights Reserved
 * Author: Alexandre Torgue <alexandre.torgue@st.com> for STMicroelectronics.
 */

#include "stm32mp13xa.dtsi"

/ {
	soc {
		cryp: cryp@54002000 {
			reg = <0x54002000 0x400>;
			status = "disabled";
		};
	};
};
